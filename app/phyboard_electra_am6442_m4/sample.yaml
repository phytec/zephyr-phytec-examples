## app/phyboard_electra_am6442_m4/sample.yaml
```yaml
# This file is provided so that the application can be compiled using Twister,
# the Zephyr testing tool. In this file, multiple combinations can be specified,
# so that you can easily test all of them locally or in CI.
sample:
  description: phyBOARD-Electra M4 Firmware
  name: example-firmware
common:
  build_only: true
  integration_platforms:
    - phyboard_electra/am6442/m4
tests:
  app.default: {}
  app.debug:
    extra_overlay_confs:
      - debug.conf
```

## app/sample.yaml
```yaml
# This file is provided so that the application can be compiled using Twister,
# the Zephyr testing tool. In this file, multiple combinations can be specified,
# so that you can easily test all of them locally or in CI.
sample:
  description: PHYTEC Example Firmware
  name: example-firmware
common:
  build_only: true
  integration_platforms:
    - phyboard_lyra/am6234/m4
    - phyboard_electra/am6442/m4
tests:
  app.default: {}
  app.debug:
    extra_overlay_confs:
      - debug.conf
```
